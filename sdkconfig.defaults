## sdkconfig.defaults
```kconfig
CONFIG_AUTOSTART_ARDUINO=y
CONFIG_FREERTOS_HZ=1000

# File system
CONFIG_PARTITION_TABLE_CUSTOM=y
CONFIG_PARTITION_TABLE_CUSTOM_FILENAME="min_spiffs.csv"
CONFIG_PARTITION_TABLE_FILENAME="min_spiffs.csv"

# Hardware timer ISR tweak
CONFIG_ESP_TIMER_INTERRUPT_LEVEL=3
CONFIG_ESP_TIMER_SUPPORTS_ISR_DISPATCH_METHOD=y
```
